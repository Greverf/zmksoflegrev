## config/boards/shields/sofle/Kconfig.shield
```kconfig
# Copyright (c) 2020 The ZMK Contributors
# SPDX-License-Identifier: MIT

config SHIELD_SOFLE_CENTRAL_DONGLE
    def_bool $(shields_list_contains,cygnus_central_dongle)

config SHIELD_SOFLE_CENTRAL_LEFT
    def_bool $(shields_list_contains,cygnus_central_left)
    
config SHIELD_SOFLE_PERIPHERAL_LEFT
    def_bool $(shields_list_contains,cygnus_peripheral_left)

config SHIELD_SOFLE_PERIPHERAL_RIGHT
    def_bool $(shields_list_contains,cygnus_peripheral_right)
```
